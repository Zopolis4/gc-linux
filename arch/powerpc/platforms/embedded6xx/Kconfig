## arch/powerpc/platforms/embedded6xx/Kconfig
```kconfig
config EMBEDDED6xx
	bool "Embedded 6xx/7xx/7xxx-based boards"
	depends on PPC32 && BROKEN_ON_SMP && PPC_MULTIPLATFORM

config LINKSTATION
	bool "Linkstation / Kurobox(HG) from Buffalo"
	depends on EMBEDDED6xx
	select MPIC
	select FSL_SOC
	select PPC_UDBG_16550 if SERIAL_8250
	select DEFAULT_UIMAGE
	help
	  Select LINKSTATION if configuring for one of PPC- (MPC8241)
	  based NAS systems from Buffalo Technology. So far only
	  KuroboxHG has been tested. In the future classical Kurobox,
	  Linkstation-I HD-HLAN and HD-HGLAN versions, and PPC-based
	  Terastation systems should be supported too.

config MPC7448HPC2
	bool "Freescale MPC7448HPC2(Taiga)"
	depends on EMBEDDED6xx
	select TSI108_BRIDGE
	select DEFAULT_UIMAGE
	select PPC_UDBG_16550
	select WANT_DEVICE_TREE
	help
	  Select MPC7448HPC2 if configuring for Freescale MPC7448HPC2 (Taiga)
	  platform

config PPC_HOLLY
	bool "PPC750GX/CL with TSI10x bridge (Hickory/Holly)"
	depends on EMBEDDED6xx
	select TSI108_BRIDGE
	select PPC_UDBG_16550
	select WANT_DEVICE_TREE
	help
	  Select PPC_HOLLY if configuring for an IBM 750GX/CL Eval
	  Board with TSI108/9 bridge (Hickory/Holly)

config PPC_PRPMC2800
	bool "Motorola-PrPMC2800"
	depends on EMBEDDED6xx
	select MV64X60
	select NOT_COHERENT_CACHE
	select WANT_DEVICE_TREE
	help
	  This option enables support for the Motorola PrPMC2800 board

config GAMECUBE
	bool "Nintendo-GameCube"
	depends on EMBEDDED6xx
	select GAMECUBE_COMMON
	select WANT_DEVICE_TREE
	help
	 Select GAMECUBE if configuring for the Nintendo GameCube.
	 More information at: <http://gc-linux.sourceforge.net/>

config WII
	bool "Nintendo-Wii"
	depends on EMBEDDED6xx
	select GAMECUBE_COMMON
	select WANT_DEVICE_TREE
	select PPC_LIB_RHEAP
	help
	 Select WII if configuring for the Nintendo Wii.
	 More information at: <http://gc-linux.sourceforge.net/>

config TSI108_BRIDGE
	bool
	depends on MPC7448HPC2 || PPC_HOLLY
	select PCI
	select MPIC
	select MPIC_WEIRD
	default y

config MPC10X_BRIDGE
	bool
	depends on LINKSTATION
	select PPC_INDIRECT_PCI
	default y

config MV64X60
	bool
	select PPC_INDIRECT_PCI
	select CHECK_CACHE_COHERENCY

config MPC10X_OPENPIC
	bool
	depends on LINKSTATION
	default y

config MPC10X_STORE_GATHERING
	bool "Enable MPC10x store gathering"
	depends on MPC10X_BRIDGE

config FLIPPER_PIC
	bool
	default n

config GAMECUBE_COMMON
	bool
	select FLIPPER_PIC
	select NOT_COHERENT_CACHE
	default n
	
config GAMECUBE_RSW
	bool "Nintendo GameCube/Wii reset switch/button"
	depends on GAMECUBE_COMMON
	default y
	help
	  If you say yes to this option, support will be included for the
	  reset switch/button of the Nintendo GameCube/Wii.
	  
	  If in doubt, say Y here.

config USBGECKO_UDBG
	bool "USB Gecko udbg console for the Nintendo GameCube/Wii"
	depends on GAMECUBE_COMMON
	default n
	help
	  If you say yes to this option, support will be included for the
	  USB Gecko adapter as an udbg console.
	  The USB Gecko is an USB serial-to-spi converter that can be plugged
	  into a memcard slot in the Nintendo GameCube/Wii.
	  
	  This driver bypasses the EXI layer completely.
	  
	  If in doubt, say N here.
```

## drivers/exi/Kconfig
```kconfig
#
# Nintendo GameCube Expansion Interface (EXI) support.
#

menu "Expansion Interface (EXI) support"

config GAMECUBE_EXI
	bool "Expansion Interface (EXI) support (EXPERIMENTAL)"
	depends on GAMECUBE && EXPERIMENTAL
	default y
	help
	  This adds support for the Expansion Interface as found in
	  the Nintendo GameCube. On the Expansion Interface sit the
	  memory card slots, serial ports I & II, the Mask ROM, RTC,
	  SRAM and UART.

	  Say Y.

config GAMECUBE_RTC
	bool "Real Time Clock and SRAM support"
	depends on GAMECUBE && GAMECUBE_EXI
	default y
	help
	  If you say yes to this option, support will be included for the
	  Real Time Clock and SRAM of the Nintendo GameCube.
	  
	  If in doubt, say Y here.

endmenu
```

## sound/ppc/Kconfig
```kconfig
# ALSA PowerMac drivers

menu "ALSA PowerMac devices"
	depends on SND!=n && PPC

comment "ALSA PowerMac requires I2C"
	depends on SND && I2C=n

comment "ALSA PowerMac requires INPUT"
	depends on SND && INPUT=n

config SND_POWERMAC
	tristate "PowerMac (AWACS, DACA, Burgundy, Tumbler, Keywest)"
	depends on SND && I2C && INPUT
	select SND_PCM

config SND_GAMECUBE
	tristate "Nintendo GameCube audio"
	depends on SND
	help
	  Say 'Y' or 'M' to include support for the Nintendo GameCube
	  audio system.

endmenu
```
